## conf/distro/rtos-industrial.conf
```bitbake
# NXP rtos-industrial Distro

DISTRO = "rtos-industrial"
DISTRO_NAME = "rtos-industrial"
DISTRO_VERSION = "1.0"

TARGET_VENDOR = "-nxp"

TCLIBC = "newlib"
TCLIBCAPPEND = ""

INHERIT += "uninative"
require conf/distro/include/yocto-uninative.inc
```

## conf/layer.conf
```bitbake
# We have a conf and classes directory, add to BBPATH
BBPATH .= ":${LAYERDIR}"

# We have recipes-* directories, add to BBFILES
BBFILES += "${LAYERDIR}/recipes-*/*/*.bb \
	${LAYERDIR}/recipes-*/*/*.bbappend"

BBFILE_COLLECTIONS += "rtos-industrial"
BBFILE_PATTERN_rtos-industrial = "^${LAYERDIR}/"
BBFILE_PRIORITY_rtos-industrial = "6"

# This should only be incremented on significant changes that will
# cause compatibility issues with other layers
LAYERVERSION_rtos-industrial = "1"

LAYERDEPENDS_rtos-industrial = "core"

LAYERSERIES_COMPAT_rtos-industrial = "mickledore nanbield scarthgap"

# Common SRC setting
NXPMICRO_BASE = "github.com/nxp-mcuxpresso"
NXP_BASE = "github.com/NXP"
NXP_REAL_TIME_EDGE_BASE = "github.com/nxp-real-time-edge-sw"
NXP_ZEPHYR_BASE = "github.com/nxp-zephyr"

MCUX_SDK_SRC ?= "git://${NXPMICRO_BASE}/mcux-sdk.git;protocol=https;nobranch=1"
MCUX_SDK_EXAMPLES_SRC ?= "git://${NXPMICRO_BASE}/mcux-sdk-examples;protocol=https;nobranch=1"
MCUX_SDK_MIDDLEWARE_MULTICORE_SRC ?= "git://${NXPMICRO_BASE}/mcux-sdk-middleware-multicore.git;protocol=https;nobranch=1"
CMSIS_SRC ?= "git://${NXPMICRO_BASE}/CMSIS_5.git;protocol=https;nobranch=1"
FREERTOS_KERNEL_SRC ?= "git://${NXPMICRO_BASE}/FreeRTOS-Kernel.git;protocol=https;nobranch=1"
RPMSG_LITE_SRC ?= "git://${NXPMICRO_BASE}/rpmsg-lite.git;protocol=https;nobranch=1"
LWIP_SRC ?= "git://${NXPMICRO_BASE}/lwip.git;protocol=https;nobranch=1"
HETEROGENEOUS_MULTICORE_SRC ?= "git://${NXP_REAL_TIME_EDGE_BASE}/heterogeneous-multicore.git;protocol=https;nobranch=1"
SOEM_SRC ?= "git://${NXP_REAL_TIME_EDGE_BASE}/soem.git;protocol=https;nobranch=1"
ZEPHYR_SRC ?= "git://${NXP_ZEPHYR_BASE}/zephyr.git;protocol=https;nobranch=1"
HAL_NXP_SRC ?= "git://${NXP_ZEPHYR_BASE}/hal_nxp.git;protocol=https;nobranch=1"

# Repo version
MCUX_SDK_SRCREV ?= "47e424c37e898ab2fc4bacca1292b74292b666c4"
MCUX_SDK_EXAMPLES_SRCREV ?= "36bfde1fe1a8989a0789db36d172006888586345"
MCUX_SDK_MIDDLEWARE_MULTICORE_SRCREV ?= "5b8772984399c3fa4c1bc3d530db09fef74349c7"
CMSIS_SRCREV ?= "bd0404d37f6f5c73b2ff87cbb7ce5a488ba150b8"
FREERTOS_KERNEL_SRCREV ?= "4befe649263966befd2a71fcd5e372e1de9c3cf7"
RPMSG_LITE_SRCREV ?= "436596cd4443d5cedd043291f45ac21504e70a4a"
LWIP_SRCREV ?= "5e1d1678fde4bb36ac1f4fe34ec0f273374c9304"
HETEROGENEOUS_MULTICORE_SRCREV ?= "65043ddae462978ad2332af07ccad41aeba2c08c"
SOEM_SRCREV ?= "7ed8daaa6199621238f895645a4f20675fa1f99b"
ZEPHYR_SRCREV ?= "d4b2f8928c8bf664f5e28d86d2477d8d8f4b8e09"
HAL_NXP_SRCREV ?= "df3962758c2b6405a11370632b08314c81dfb1e5"
```

## conf/machine/evkbimxrt1050.conf
```bitbake
#@TYPE: Machine
#@NAME: evkbimxrt1050
#@DESCRIPTION: Machine configuration for evkbimxrt1050 Board.

require conf/machine/include/imxrt.inc

# TARGET_SYS = "arm-none-eabi"
```

## conf/machine/evkmimx8mm.conf
```bitbake
#@TYPE: Machine
#@NAME: evkmimx8mm
#@DESCRIPTION: Machine configuration for evkmimx8mm Board.

require conf/machine/include/arm/armv7m/tune-cortexm4.inc

MACHINEOVERRIDES =. "imx8mm:"

TUNE_FEATURES = "armv7m cortexm4"

ARCH = "arm"

RTOS-INDUSTRIAL-BOARD = "${MACHINE}"

EXAMPLE_TARGET_TYPE = " \
    release \
    flash_release \
    ddr_release \
"
```

## conf/machine/evkmimx8mp.conf
```bitbake
#@TYPE: Machine
#@NAME: evkmimx8mp
#@DESCRIPTION: Machine configuration for evkmimx8mp Board.

require conf/machine/include/arm/armv7m/tune-cortexm7.inc

MACHINEOVERRIDES =. "imx8mp:"

TUNE_FEATURES = "armv7m cortexm7"

ARCH = "arm"

RTOS-INDUSTRIAL-BOARD = "${MACHINE}"

#TARGET_SYS = "arm-none-eabi"

EXAMPLE_TARGET_TYPE = " \
    release \
    flash_release \
    ddr_release \
"
```

## conf/machine/include/imxrt.inc
```bitbake
#@TYPE: Machine
#@NAME: iMXRT

#@DESCRIPTION: Machine configuration for NXP Semiconductor iMXRT SoC.

# require conf/machine/include/arm/armv7m/tune-cortexm7.inc
#require conf/machine/include/tune-cortex-m0.inc
require conf/machine/include/tune-cortexm4.inc

MACHINEOVERRIDES =. "imxrt:"

# TUNE_FEATURES = "armv7m cortexm7"
TUNE_FEATURES = "armv7m cortexm4"
# TUNE_FEATURES = "armv6m cortexm0"

ARCH:imxrt = "arm"

# TUNE_ARCH = "arm"
# TARGET_SYS = "arm-none-eabi"
# TARGET_ARCH = "arm"

RTOS-INDUSTRIAL-BOARD ?= "${MACHINE}"

EXAMPLE_TARGET_TYPE ?= " \
    release \
    flexspi_nor_release \
    flexspi_nor_sdram_release \
    sdram_release \
"
```

## conf/machine/mcimx93evk.conf
```bitbake
#@TYPE: Machine
#@NAME: mcimx93evk
#@DESCRIPTION: Machine configuration for mcimx93evk Board.

require conf/machine/include/arm/armv8-m/tune-cortexm33.inc

MACHINEOVERRIDES =. "imx93:"

TUNE_FEATURES = "armv8m-main cortexm33"

ARCH = "arm"

RTOS-INDUSTRIAL-BOARD = "${MACHINE}"

EXAMPLE_TARGET_TYPE = " \
    release \
    flash_release \
    ddr_release \
"
```
